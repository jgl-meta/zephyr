## drivers/flash/Kconfig.dw_qspi
```kconfig
#Copyright(c) 2023 Meta
#SPDX - License - Identifier : Apache - 2.0

config FLASH_DW_QSPI_NOR
	bool "Designware Quad SPI Flash driver"
	default y
	depends on DT_HAS_SNPS_QSPI_NOR_ENABLED
	select FLASH_HAS_PAGE_LAYOUT
	select FLASH_HAS_DRIVER_ENABLED
	help
	  Enable Designware QSPI-NOR support.

if FLASH_DW_QSPI_NOR

config DW_SPI_DRAIN_TIMEOUT_MS
	int "Time to wait for QSPI operations to complete in milliseconds."
	default 20000
	help
		Default timeout parameter for QSPI operations.

config DW_SPI_READ_TIMEOUT_MS
	int "Time to wait for QSPI read operations before timing out in milliseconds."
	default 100
	help
		Default timeout parameter for QSPI read operations.

config DW_ERASE_SECTION_SIZE
	int "The size in KB to erase in a section"
	default 262144
	help
		Default section size to erase default is 256 * 1024 has to be in multiples of 256KB

config FLASH_JESD216_API
	bool "Designware Quad SPI Flash driver"
	default n
	help
		Enables the JESD216 api functions.

config FLASH_PAGE_SIZE
	int "Page size the driver will use when reading and writing"
	default 256
	help
		Sets the size of the page.

endif
```

## dts/bindings/flash_controller/snps,qspi-nor.yaml
```yaml
# Copyright (c) 2023 Meta
# SPDX-License-Identifier: Apache-2.0

description: Designware Quad-SPI NOR flash controller

compatible: "snps,qspi-nor"

include: flash-controller.yaml

properties:
  clock-frequency:
    type: int
    required: true
    description: Clock frequency information for Designware QSPI NOR Flash
  ahb-bus-frequency:
    type: int
    required: true
    description: Default AHB bus frequency for Designware QSPI Flash
  pp-lanes:
    type: int
    required: true
    description: Number of pp lanes to use in page program
```

## dts/bindings/inference/meta,pe-array-emul.yaml
```yaml
	
# Copyright (c) 2023 Meta Platforms Inc. and affiliates.
#
# SPDX-License-Identifier: Apache-2.0

description: Meta Processing Element Array for Inference Accelerators (Emulator)

compatible: "meta,pe-array-emul"

include: [base.yaml]

properties:
    reg:
      required: true

    array-size:
      type: int
      required: true
      description: Number of processing elements
```

## dts/bindings/inference/meta,pe-array.yaml
```yaml
# Copyright (c) 2023 Meta Platforms Inc. and affiliates.
#
# SPDX-License-Identifier: Apache-2.0

description: Meta Processing Element Array for Inference Accelerators

compatible: "meta,pe-array"

# technically, both this and meta,pe-array-emul could both depend on a shared yaml but I'm not
# exactly sure how common that is. The main difference between this and the other is that this
# requires interrupts.
include: [base.yaml]

properties:
    reg:
      required: true

    array-size:
      type: int
      required: true
      description: Number of processing elements

    interrupts:
      required: true
```
